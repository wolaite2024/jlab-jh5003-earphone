## src/sample/common/Kconfig
```kconfig
menuconfig REALTEK_APP_COMMON
    bool "common"
	default n
	help
	  app common feature
	  
if REALTEK_APP_COMMON

config REALTEK_APP_BUZEER_ENABLE
    bool "use app buzeer"
	default n
	help
	   compile app_buzzer.c

config REALTEK_APP_CFU_TRANSFER_ENABLE
    bool "use app cfu transfer"
	default n
	help
	   compile app_cfu_transfer.c

config REALTEK_APP_COMMON_CFU_ENABLE
    bool "use app common cfu"
	default n
	help
	   compile app_common_cfu.c

config REALTEK_APP_DSP_CONFIG_ENABLE
    bool "use app dsp cfg"
	default n
	help
	   compile app_dsp_cfg.c

config REALTEK_APP_GPIO_ON_OFF_ENABLE
    bool "support app gpio on off"
	default n
	help
	   compile app_gpio_on_off.c

config REALTEK_APP_ONE_WIRE_UART_ENABLE
    bool "use app one wire uart"
	default n
	help
	   compile app_one_wire_uart.c

config REALTEK_APP_NREC_ENABLE
    bool "use app nrec"
	default n
	help
	   compile app_nrec.c
	   
config REALTEK_APP_SIDETONE_ENABLE
    bool "use app side tone"
	default n
	help
	   compile app_sidetone.c

config REALTEK_APP_SNIFF_MODE_ENABLE
    bool "use app sniff mode"
	default n
	help
	   compile app_sniff_mode.c
endif
```
